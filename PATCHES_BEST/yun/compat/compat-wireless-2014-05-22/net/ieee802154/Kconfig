## PATCHES_BEST/yun/compat/compat-wireless-2014-05-22/net/ieee802154/Kconfig
```kconfig
config IEEE802154
	depends on !BACKPORT_KERNEL_3_1
	tristate "IEEE Std 802.15.4 Low-Rate Wireless Personal Area Networks support"
	depends on m
	---help---
	  IEEE Std 802.15.4 defines a low data rate, low power and low
	  complexity short range wireless personal area networks. It was
	  designed to organise networks of sensors, switches, etc automation
	  devices. Maximum allowed data rate is 250 kb/s and typical personal
	  operating space around 10m.

	  Say Y here to compile LR-WPAN support into the kernel or say M to
	  compile it as modules.

config IEEE802154_6LOWPAN
	depends on !BACKPORT_KERNEL_3_5
	tristate "6lowpan support over IEEE 802.15.4"
	depends on m
	depends on IEEE802154 && IPV6
	select 6LOWPAN_IPHC
	---help---
	  IPv6 compression over IEEE 802.15.4.

config 6LOWPAN_IPHC
	tristate
	depends on m
	---help---
	  6lowpan compression code which is shared between IEEE 802.15.4 and Bluetooth
	  stacks.
```

## drivers/extcon/Kconfig.rej
```kconfig
--- drivers/extcon/Kconfig	2019-04-05 16:31:40.000000000 -0400
+++ drivers/extcon/Kconfig	2019-11-22 06:58:54.231351723 -0500
@@ -44,7 +44,8 @@
 
 config EXTCON_INTEL_INT3496
 	tristate "Intel INT3496 ACPI device extcon driver"
-	depends on GPIOLIB && ACPI && (X86 || COMPILE_TEST)
+	depends on GPIOLIB && ACPI && X86
+	select MULTIPLEXER
 	help
 	  Say Y here to enable extcon support for USB OTG ports controlled by
 	  an Intel INT3496 ACPI device.
```
